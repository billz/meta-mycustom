## conf/layer.conf
```bitbake
BBPATH .= ":${LAYERDIR}"
BBFILES += "${LAYERDIR}/recipes-*/*/*.bb \
            ${LAYERDIR}/recipes-*/*/*.bbappend"
FILESEXTRAPATHS:prepend := "${LAYERDIR}/files:"
LAYERSERIES_COMPAT_meta-mycustom = "kirkstone"
MINWRITE_ENABLED = "1"
```
